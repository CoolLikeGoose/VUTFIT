## 3BIT/IMP/Esp32Temperature/src/Kconfig.projbuild
```kconfig
menu "Temperature controller"

    config WIFI_SSID
        string "Wifi SSID"
        default ""
    
    config WIFI_PWD 
        string "Wifi password"
        default ""

    config TEMPERATURE_THRESHOLD
        string "Temperature threshold"
        default ""

    config HYSTERESIS
        string "HYSTERESIS"
        default ""

    config MQTT_BROKER_URL
        string "MQTT Broker url"
        default ""

endmenu
```
